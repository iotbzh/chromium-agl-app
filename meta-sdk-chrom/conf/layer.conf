## meta-sdk-chrom/conf/layer.conf
```bitbake
# We have a conf and classes directory, add to BBPATH
BBPATH =. "${LAYERDIR}:"

# We have recipes-* directories, add to BBFILES
BBFILES += "${LAYERDIR}/recipes-*/*/*.bb \
            ${LAYERDIR}/recipes-*/*/*.bbappend"

BBFILE_COLLECTIONS += "sdk-chrom"
BBFILE_PATTERN_sdk-chrom= "^${LAYERDIR}/"
BBFILE_PRIORITY_sdk-chrom = "7"
```
